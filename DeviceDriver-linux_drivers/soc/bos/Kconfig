## DeviceDriver-linux_drivers/soc/bos/Kconfig
```kconfig
# Add BOS SoC to Linux Kernel - Added by KahngJu (24/11/19)
config BOS_DRIVER
	bool "BOS SoC device drivers"
	help
	  This enables device drivers for BOS SoC
```

## DeviceTree-linux_arch_arm64/configs/superSoC_defconfig
```kconfig
CONFIG_SYSVIPC=y
CONFIG_POSIX_MQUEUE=y
CONFIG_NO_HZ_IDLE=y
CONFIG_HIGH_RES_TIMERS=y
CONFIG_TASKSTATS=y
CONFIG_MEMCG=y
CONFIG_BLK_CGROUP=y
CONFIG_CPUSETS=y
CONFIG_CGROUP_DEVICE=y
CONFIG_CGROUP_CPUACCT=y
CONFIG_SCHED_AUTOGROUP=y
CONFIG_PROFILING=y
CONFIG_ARCH_VEXPRESS=y
CONFIG_COMPAT=y
CONFIG_FW_CFG_SYSFS=y
CONFIG_FW_CFG_SYSFS_CMDLINE=y
CONFIG_MODULES=y
CONFIG_MODULE_UNLOAD=y
CONFIG_BLK_DEV_BSGLIB=y
CONFIG_BINFMT_MISC=y
CONFIG_TRANSPARENT_HUGEPAGE=y
CONFIG_NET=y
CONFIG_PACKET=y
CONFIG_PACKET_DIAG=y
CONFIG_UNIX=y
CONFIG_NET_KEY=y
CONFIG_INET=y
CONFIG_IP_MULTICAST=y
CONFIG_IP_ADVANCED_ROUTER=y
CONFIG_BRIDGE=m
CONFIG_NET_SCHED=y
CONFIG_VSOCKETS=y
CONFIG_PCI=y
CONFIG_PCI_HOST_GENERIC=y
CONFIG_DEVTMPFS=y
CONFIG_DEVTMPFS_MOUNT=y
CONFIG_VIRTIO_BLK=y
CONFIG_BLK_DEV_SD=y
CONFIG_CHR_DEV_SG=y
CONFIG_SCSI_CONSTANTS=y
CONFIG_SCSI_LOGGING=y
CONFIG_SCSI_SCAN_ASYNC=y
CONFIG_SCSI_VIRTIO=y
CONFIG_ATA=y
CONFIG_NETDEVICES=y
CONFIG_DUMMY=y
CONFIG_MACVLAN=y
CONFIG_VIRTIO_NET=y
CONFIG_NLMON=y
CONFIG_INPUT_EVDEV=y
CONFIG_SERIAL_AMBA_PL011=y
CONFIG_SERIAL_AMBA_PL011_CONSOLE=y
CONFIG_VIRTIO_CONSOLE=y
CONFIG_HW_RANDOM=y
CONFIG_HW_RANDOM_VIRTIO=y
CONFIG_TCG_TPM=y
CONFIG_TCG_TIS=y
CONFIG_DRM=y
CONFIG_DRM_VIRTIO_GPU=y
CONFIG_FB=y
CONFIG_RTC_CLASS=y
CONFIG_RTC_DRV_PL031=y
CONFIG_VIRTIO_PCI=y
CONFIG_VIRTIO_INPUT=y
CONFIG_VIRTIO_MMIO=y
CONFIG_VIRTIO_MMIO_CMDLINE_DEVICES=y
CONFIG_MAILBOX=y
CONFIG_PL320_MBOX=y
CONFIG_ARM_SMMU_V3=y
CONFIG_EXT4_FS=y
CONFIG_FUSE_FS=y
CONFIG_VIRTIO_FS=y
CONFIG_OVERLAY_FS=y
CONFIG_TMPFS=y
CONFIG_TMPFS_POSIX_ACL=y

# =============== for BOS config ===============
# Add BOS SoC platform config to kernel - Added by KahngJu(24/11/16)
CONFIG_ARCH_BOS=y

# Add BOS SoC driver config to kernel - Added by KahngJu(24/11/19)
CONFIG_BOS_DRIVER=y

# Add to use Initramfs - Added by KahngJu(24/11/18)
CONFIG_BLK_DEV_INITRD=y                 # 초기 RAM 디스크(initrd), 초기 RAM 파일시스템(initramfs) 지원을 활성화(커널이 부팅 시 임시 루트 파일시스템을 메모리에 로드 가능)
CONFIG_RD_GZIP=y                        # GZIP으로 압축된 initramfs 이미지를 지원

# Add GPIO controller to kernel - Added by KahngJu(24/11/18)
CONFIG_GPIO_PL061=y                     # PrimeCell PL061 GPIO 컨트롤러 지원을 활성화
CONFIG_GPIOLIB=y                        # GPIO 지원 라이브러리를 활성화(GPIO 핀을 제어하기 위한 공통 인터페이스 활성화)
CONFIG_GPIO_SYSFS=y                     # sysfs를 통한 GPIO 제어를 활성화(유저 공간에서 GPIO를 제어) 

# Add DMA controller to kernel - Added by KahngJu(24/11/18)
CONFIG_DMADEVICES=y                     # DMA 장치 지원을 활성화
CONFIG_DMA_ENGINE=y                     # DMA 엔진(DMA 작업을 관리하기 위한 프레임워크) 지원을 활성화
CONFIG_PL330_DMA=y                      # PL330 DMA 컨트롤러 지원을 활성화

# Add voltage regulator to kernel - Added by KahngJu(24/11/18)
CONFIG_REGULATOR=y                      # 전압 및 전류 조정기 지원을 활성화
CONFIG_REGULATOR_FIXED_VOLTAGE=y        # 고정 전압 조정기 지원을 활성화

# Add SPI to kernel - Added by KahngJu(24/11/18)
CONFIG_SPI=y                            # SPI 버스 지원 활성화
CONFIG_SPI_PL022=y                      # ARM AMBA PL022 SSP 컨트롤러 지원을 활성화
CONFIG_SPI_SPIDEV=y                     ## SPI 툴을 사용하기 위해 필요한 설정 : SPI 툴을 사용하기 위해서는 spidev를 사용해야 함

# Add I2C to kernel - Added by KahngJu(24/11/18)
CONFIG_I2C=y                           # I2C 버스 지원 활성화
CONFIG_I2C_VERSATILE=y                 # Versatile I2C 어댑터 지원을 활성화
CONFIG_I2C_CHARDEV=y                   ## I2C 툴을 사용하기 위해 필요한 설정 : CHARDEV를 추가하지 않으면 /dev에 I2C 컨트롤러 디바이스 노드가 없음

CONFIG_GPIOLIB_IRQCHIP=y            # GPIO 핀을 인터럽트 소스로 사용할 수 있게 설정
CONFIG_MMC=y                        # MMC/SD/SDIO 카드 지원을 활성화
CONFIG_I2C_ALGOBIT=y                
```
